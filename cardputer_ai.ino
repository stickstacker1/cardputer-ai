// Cardputer ADV — on-device chat with Maykeye/TinyLLama-v0 (4.6M params).
//
// The Q4_0 model and SentencePiece tokenizer are compiled into the firmware
// (model_data.cpp and tok_data.cpp, generated by tools/convert_tinyllama_v0.py).
// Flashing the .bin via bmorcelli/Launcher installs everything in one step —
// no SD card required.

#include <M5Cardputer.h>
#include "llm.h"
#include "ui.h"

// Symbols defined by the generated model_data.cpp and tok_data.cpp (produced
// by tools/convert_tinyllama_v0.py). They land in the .rodata section, which
// the ESP32-S3 maps from flash directly into the data address space — so
// inference reads them as if they were ordinary RAM.
extern "C" const uint8_t MODEL_DATA[];
extern "C" const size_t  MODEL_DATA_LEN;
extern "C" const uint8_t TOKENIZER_DATA[];
extern "C" const size_t  TOKENIZER_DATA_LEN;

static Transformer transformer;
static Tokenizer   tokenizer;
static Sampler     sampler;
static ChatUI      ui;

// KV-cache window. The model was trained for 2048, but 8 layers × 16 heads ×
// head_size 4 × bf16 × 2 (k+v) × N ≈ 2 KB × N. We have ~280 KB free heap to
// share with the 128 KB logits buffer; the bf16 cache (see llm.cpp) makes 64
// positions cost the same 128 KB that 32 used to in fp32.
static constexpr int KV_SEQ_LEN = 64;
static constexpr float DEFAULT_TEMP = 0.8f;

enum AppState { ST_BOOT, ST_CHAT, ST_SETTINGS };
static AppState state = ST_BOOT;

// ---------- Settings ----------

struct Settings {
  float temp      = DEFAULT_TEMP;     // 0.0 = greedy (argmax)
  int   max_reply = KV_SEQ_LEN - 1;   // tokens per reply, <= KV window
};
static Settings settings;
static int sett_sel = 0;
static constexpr int SETT_N = 3;

static void drawSettings() {
  String names[SETT_N]  = {"Temperature", "Max reply tokens", "RNG seed"};
  String values[SETT_N];
  values[0] = settings.temp < 0.05f ? String("0.0 greedy") : String(settings.temp, 1);
  values[1] = String(settings.max_reply);
  values[2] = "reroll with , /";
  ui.showSettings("Settings", names, values, SETT_N, sett_sel);
}

static void adjustSetting(int dir) {
  switch (sett_sel) {
    case 0:
      settings.temp = roundf((settings.temp + 0.1f * dir) * 10.0f) / 10.0f;
      settings.temp = constrain(settings.temp, 0.0f, 2.0f);
      sampler.temperature = settings.temp;        // takes effect immediately
      break;
    case 1:
      settings.max_reply = constrain(settings.max_reply + dir, 4, KV_SEQ_LEN - 1);
      break;
    case 2:
      llm_build_sampler(&sampler, transformer.config.vocab_size,
                        settings.temp, esp_random());
      break;
  }
  drawSettings();
}

static void leaveSettings() {
  state = ST_CHAT;
  ui.repaint();
  ui.statusf("T=%.1f  len=%d  [tab] settings", settings.temp, settings.max_reply);
}

struct GenState {
  bool active = false;
  int pos = 0, next = 0, token = 0, n_prompt = 0;
  int* prompt_tokens = nullptr;
  uint32_t t_start_ms = 0;
  int tokens_out = 0;
} gen;

static void initModel() {
  ui.statusf("Loading model (%u KB)...", (unsigned)(MODEL_DATA_LEN / 1024));
  if (!llm_init_embedded(&transformer, MODEL_DATA, MODEL_DATA_LEN, KV_SEQ_LEN)) {
    ui.fatal("model init failed (bad header or OOM)");
  }
  ui.statusf("Tokenizer (%u KB)...", (unsigned)(TOKENIZER_DATA_LEN / 1024));
  if (!llm_tokenizer_from_memory(&tokenizer, TOKENIZER_DATA, TOKENIZER_DATA_LEN,
                                 transformer.config.vocab_size)) {
    ui.fatal("tokenizer init failed");
  }
  llm_build_sampler(&sampler, transformer.config.vocab_size, DEFAULT_TEMP, esp_random());
}

static void beginGeneration(const String& user_text) {
  if (gen.prompt_tokens) { free(gen.prompt_tokens); gen.prompt_tokens = nullptr; }
  gen.prompt_tokens = (int*) malloc(sizeof(int) * (user_text.length() + 8));
  if (!gen.prompt_tokens) { ui.appendBot("[OOM]\n"); return; }
  llm_encode(&tokenizer, user_text.c_str(), 1, 0, gen.prompt_tokens, &gen.n_prompt);
  if (gen.n_prompt < 1) { ui.appendBot("[empty]\n"); return; }
  gen.token       = gen.prompt_tokens[0];
  gen.pos         = 0;
  gen.next        = 0;
  gen.active      = true;
  gen.t_start_ms  = millis();
  gen.tokens_out  = 0;
  ui.beginBotReply();
}

static void stepGeneration() {
  if (gen.pos >= KV_SEQ_LEN - 1 || gen.tokens_out >= settings.max_reply) {
    gen.active = false;
    ui.endBotReply(gen.tokens_out, millis() - gen.t_start_ms);
    return;
  }
  float* logits = llm_forward(&transformer, gen.token, gen.pos);

  if (gen.pos < gen.n_prompt - 1) {
    gen.next = gen.prompt_tokens[gen.pos + 1];
  } else {
    gen.next = llm_sample(&sampler, logits);
    if (gen.next == 1 || gen.next == 2) {
      gen.active = false;
      ui.endBotReply(gen.tokens_out, millis() - gen.t_start_ms);
      return;
    }
    char scratch[32];
    const char* piece = llm_decode(&tokenizer, gen.token, gen.next, scratch, sizeof(scratch));
    if (piece && *piece) ui.appendBot(piece);
    gen.tokens_out++;
  }
  gen.token = gen.next;
  gen.pos++;
}

void setup() {
  auto cfg = M5.config();
  M5Cardputer.begin(cfg, true);
  ui.begin();

  ui.status("TinyLLama-v0 booting...");
  initModel();

  ui.ready();
  ui.statusf("TinyLLama-v0  T=%.1f  [tab] settings", settings.temp);
  state = ST_CHAT;
}

void loop() {
  M5Cardputer.update();

  if (state == ST_SETTINGS) {
    if (M5Cardputer.Keyboard.isChange() && M5Cardputer.Keyboard.isPressed()) {
      auto st = M5Cardputer.Keyboard.keysState();
      if (st.tab || st.enter) { leaveSettings(); return; }
      for (char c : st.word) {
        if (c == ';') { sett_sel = (sett_sel + SETT_N - 1) % SETT_N; drawSettings(); }
        if (c == '.') { sett_sel = (sett_sel + 1) % SETT_N; drawSettings(); }
        if (c == ',') adjustSetting(-1);
        if (c == '/') adjustSetting(+1);
      }
    }
    return;
  }
  if (state != ST_CHAT) return;

  if (gen.active) { ui.tickGenerating(gen.tokens_out); stepGeneration(); return; }
  if (M5Cardputer.Keyboard.isChange() && M5Cardputer.Keyboard.isPressed()) {
    auto st = M5Cardputer.Keyboard.keysState();
    if (st.tab) {                      // open settings (only when idle)
      state = ST_SETTINGS;
      sett_sel = 0;
      drawSettings();
      return;
    }
    if (st.fn) {
      // fn+; / fn+. are the up/down arrows on the Cardputer keyboard —
      // scroll the chat history (2 lines per press).
      for (char c : st.word) {
        if (c == ';') ui.scrollChat(+2);
        if (c == '.') ui.scrollChat(-2);
      }
    } else {
      for (char c : st.word) ui.onChar(c);
      if (st.del)   ui.onBackspace();
      if (st.enter) {
        String prompt = ui.takeInput();
        if (prompt.length()) {
          ui.appendUser(prompt);
          beginGeneration(prompt);
        }
      }
    }
  }
}
